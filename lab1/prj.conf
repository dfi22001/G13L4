## CMakeLists.txt
```
# SPDX-License-Identifier: Apache-2.0

cmake_minimum_required(VERSION 3.20.0)

find_package(Zephyr REQUIRED HINTS $ENV{ZEPHYR_BASE})
project(peripheral_hr)

target_sources(app PRIVATE
  src/main.c
  src/bt_stuff.c
  )
```

## prj.conf
```kconfig
CONFIG_BT=y
CONFIG_BT_DEBUG_LOG=n
CONFIG_BT_SMP=y
CONFIG_BT_PERIPHERAL=y
CONFIG_BT_DIS=n
CONFIG_BT_DIS_PNP=n
CONFIG_BT_BAS=n
CONFIG_BT_HRS=y
CONFIG_BT_DEVICE_NAME="Zephyr_device_demo"
CONFIG_BT_DEVICE_APPEARANCE=833
```

## src/main.c
```c
/* main.c - Application main entry point */

/*
 * Copyright (c) 2015-2016 Intel Corporation
 *
 * SPDX-License-Identifier: Apache-2.0
 */

#include <zephyr/types.h>
#include <stddef.h>
#include <string.h>
#include <errno.h>
#include <zephyr/sys/printk.h>
#include <zephyr/sys/byteorder.h>
#include <zephyr/kernel.h>
#include "bt_stuff.h"


void main(void)
{

  uint8_t heartrate = 0U;
	uint8_t status = turn_on_bt();
	if (!status){
		printk("BT seems to have started just fine \n");
	} else {
		printk("oh shit!\n");
	}

	while (1) {
		heartrate++;
		bt_hrs_notify(heartrate);
		k_sleep(K_SECONDS(1));
	}
}
```

## src/bt_stuff.c
```c
#include <zephyr/types.h>
#include <stddef.h>
#include <string.h>
#include <errno.h>
#include <zephyr/sys/printk.h>
#include <zephyr/sys/byteorder.h>
#include <zephyr/kernel.h>
#include "bt_stuff.h"



static void connected(struct bt_conn *conn, uint8_t err)
{
	if (err) {
		printk("Connection failed (err 0x%02x)\n", err);
	} else {
		printk("Connected\n");
	}
}

static void disconnected(struct bt_conn *conn, uint8_t reason)
{
	printk("Disconnected (reason 0x%02x)\n", reason);
}

BT_CONN_CB_DEFINE(conn_callbacks) = {
	.connected = connected,
	.disconnected = disconnected,
};

void bt_ready(void)
{
	int err;

	printk("Bluetooth initialized\n");

	err = bt_le_adv_start(BT_LE_ADV_CONN_NAME, ad, ARRAY_SIZE(ad), NULL, 0);
	if (err) {
		printk("Advertising failed to start (err %d)\n", err);
		return;
	}

	printk("Advertising successfully started\n");
}

//void hrs_notify(void)
//{


	/* Heartrate measurements simulation */
//	heartrate++;
//	if (heartrate == 160U) {
//		heartrate = 90U;
//	}

//	bt_hrs_notify(heartrate);
//}

uint8_t turn_on_bt(void)
{
	int err;
	err = bt_enable(NULL);
	if (err) {
		printk("Bluetooth init failed (err %d)\n", err);
		return 1;
	}

	bt_ready();
	bt_addr_le_t addr;
	char addr_s[BT_ADDR_LE_STR_LEN];
	size_t id_count = 1;
	bt_id_get(&addr, &id_count);
	bt_addr_le_to_str(&addr, addr_s, sizeof(addr_s));
	printk("addr: %s", addr_s);
	return 0;


}
```

## src/bt_stuff.h
```c
#ifndef BT_STUFF_H_
#define BT_STUFF_H_

#include <zephyr/bluetooth/bluetooth.h>
#include <zephyr/bluetooth/addr.h>
#include <zephyr/bluetooth/hci.h>
#include <zephyr/bluetooth/conn.h>
#include <zephyr/bluetooth/uuid.h>
#include <zephyr/bluetooth/gatt.h>
#include <zephyr/bluetooth/services/bas.h>
#include <zephyr/bluetooth/services/hrs.h>

static const struct bt_data ad[] = {
	BT_DATA_BYTES(BT_DATA_FLAGS, (BT_LE_AD_GENERAL | BT_LE_AD_NO_BREDR)),
	BT_DATA_BYTES(BT_DATA_UUID16_ALL,
		      BT_UUID_16_ENCODE(BT_UUID_HRS_VAL))
};
uint8_t turn_on_bt(void);
//void hrs_notify(void);

#endif
```
